/* Code order of the Linux executable.
 *
 * Linux maps an executable's pages in 64 KiB windows around each page a
 * process touches, so a command whose functions lie apart holds many windows
 * it never runs. This script places the process entry, the gzip decoder, the
 * functions every command runs, and then each command family's own functions
 * next to each other. Each function starts on a 64-byte boundary and each
 * family on a page, so that a change in one function or family does not move
 * the alignment of the others. A function that matches no pattern stays in
 * .text: a stale pattern costs memory and nothing else.
 */
SECTIONS
{
  .text.ordered : ALIGN(4096) SUBALIGN(64) {
    *x86_64_entry.o(.text .text.*)
    *libcompiler_rt.a:(.text .text.*)
    . = ALIGN(4096);
    *(.text..Lstream.reader.Decompressor*.fill .text.stream.reader.Decompressor*.fill)
    *(.text..Lengine.decode.decodeFast__anon_* .text.engine.decode.decodeFast__anon_*)
    *(.text..Lengine.decode.decodeHuff__anon_* .text.engine.decode.decodeHuff__anon_*)
    *(.text..Lengine.decode.decodeTail__anon_* .text.engine.decode.decodeTail__anon_*)
    *(.text..Lengine.decode.BitReader.fill .text.engine.decode.BitReader.fill)
    *(.text..Lengine.codes.buildCodes .text.engine.codes.buildCodes)
    *(.text..Lkernel.crc32.updateState .text.kernel.crc32.updateState)
    *(.text..Lengine.decode.readDynLensFast .text.engine.decode.readDynLensFast)
    *(.text..Lengine.decode.Session*.copyMatch .text.engine.decode.Session*.copyMatch)
    *(.text..Lcrc32_x86_pclmul.updateExport .text.crc32_x86_pclmul.updateExport)
    *(.text..Lengine.decode.BitReader.getBytes .text.engine.decode.BitReader.getBytes)
    *(.text..Lstream.reader.Decompressor*.rebase .text.stream.reader.Decompressor*.rebase)
    *(.text..Lstream.reader.Decompressor*.readVec .text.stream.reader.Decompressor*.readVec)
    . = ALIGN(4096);
    *(.text..Lmain.main .text.main.main)
    *(.text..Lmemmove .text.memmove)
    *(.text..Lmem.findScalarPos__anon_* .text.mem.findScalarPos__anon_*)
    *(.text..LIo.Threaded.operate .text.Io.Threaded.operate)
    *(.text..Lheap.debug_allocator.DebugAllocator*.alloc .text.heap.debug_allocator.DebugAllocator*.alloc)
    *(.text..Lstart.posixCallMainAndExit .text.start.posixCallMainAndExit)
    *(.text..Lmemcpy .text.memcpy)
    *(.text..Lmain.RecordInput.init .text.main.RecordInput.init)
    *(.text..LIo.File.Reader.readVecStreaming .text.Io.File.Reader.readVecStreaming)
    *(.text..Lsimd.checkEntryCpu .text.simd.checkEntryCpu)
    *(.text..Lheap.PageAllocator.alloc .text.heap.PageAllocator.alloc)
    *(.text..Lmem.eqlBytes .text.mem.eqlBytes)
    *(.text..LIo.Reader.fillUnbuffered .text.Io.Reader.fillUnbuffered)
    *(.text..Lmemset .text.memset)
    *(.text..LIo.File.Reader.readVec .text.Io.File.Reader.readVec)
    *(.text..LIo.Reader.defaultRebase .text.Io.Reader.defaultRebase)
    *(.text..LThread.maybeAttachSignalStack .text.Thread.maybeAttachSignalStack)
    *(.text..LIo.Threaded.fileClose .text.Io.Threaded.fileClose)
    *(.text..Lstrlen .text.strlen)
    *(.text..Lsimd.x86_64Entry .text.simd.x86_64Entry)
    . = ALIGN(4096);
    *(.text..LIo.Threaded.dirOpenFilePosix .text.Io.Threaded.dirOpenFilePosix)
    *(.text..Lmain.checkedStdoutIdentity .text.main.checkedStdoutIdentity)
    *(.text..LIo.Threaded.fileWriteStreaming .text.Io.Threaded.fileWriteStreaming)
    *(.text..Lmain.outputFileFailure .text.main.outputFileFailure)
    *(.text..Lmain.initRecordInput .text.main.initRecordInput)
    *(.text..Lmain.validateRecordCommandInputs .text.main.validateRecordCommandInputs)
    *(.text..LIo.Writer.alignBuffer .text.Io.Writer.alignBuffer)
    *(.text..Lmain.RecordInput.readScannerChunk .text.main.RecordInput.readScannerChunk)
    *(.text..Lcount_scan.Scanner.finishLine .text.count_scan.Scanner.finishLine)
    *(.text..Lcount_scan.Scanner.learnDenseLayout .text.count_scan.Scanner.learnDenseLayout)
    *(.text..Lmain.runCount .text.main.runCount)
    *(.text..Lsimd.bestTier .text.simd.bestTier)
    *(.text..Lsimd.findNewlineFor__anon_* .text.simd.findNewlineFor__anon_*)
    . = ALIGN(4096);
    *(.text..Lfastq.LineFeedSearch.find__anon_* .text.fastq.LineFeedSearch.find__anon_*)
    *(.text..Lfastq.hasInvalidQuality .text.fastq.hasInvalidQuality)
    *(.text..Lfastq.scanSequenceLineFor__anon_* .text.fastq.scanSequenceLineFor__anon_*)
    *(.text..Lfastq.classifySemanticBytes__anon_* .text.fastq.classifySemanticBytes__anon_*)
    *(.text..Lfastq.firstInvalidChunk .text.fastq.firstInvalidChunk)
    *(.text..Lfastq.CheckScanner.consumeLineBytes .text.fastq.CheckScanner.consumeLineBytes)
    *(.text..Lfastq.CheckScanner.feed .text.fastq.CheckScanner.feed)
    *(.text..Lfastq.CheckScanner.finishEof .text.fastq.CheckScanner.finishEof)
    *(.text..Lfastq.CheckScanner.finishLine .text.fastq.CheckScanner.finishLine)
    *(.text..Lmain.checkRecordInput .text.main.checkRecordInput)
    *(.text..Lmain.runSingleCheckCommand .text.main.runSingleCheckCommand)
    *(.text..LIo.File.Writer.drain .text.Io.File.Writer.drain)
    *(.text..LIo.Writer.defaultFlush .text.Io.Writer.defaultFlush)
    *(.text..Ljson.Stringify.encodeJsonString .text.json.Stringify.encodeJsonString)
    *(.text..Ljson.Stringify.encodeJsonStringChars .text.json.Stringify.encodeJsonStringChars)
    *(.text..Ljson.Stringify.indent .text.json.Stringify.indent)
    *(.text..Ljson.Stringify.valueStartAssumeTypeOk .text.json.Stringify.valueStartAssumeTypeOk)
    *(.text..Ljson.Stringify.write__anon_* .text.json.Stringify.write__anon_*)
    *(.text..Lmain.writeEscapedBytes__anon_* .text.main.writeEscapedBytes__anon_*)
    *(.text..Lmain.writeJsonHeader .text.main.writeJsonHeader)
    *(.text..Lunicode.utf8ValidateSlice .text.unicode.utf8ValidateSlice)
    *(.text..Lmain.writeEscapedJsonString .text.main.writeEscapedJsonString)
    *(.text..Lmain.beginJsonDocument .text.main.beginJsonDocument)
    *(.text..Lmain.finishJsonDocument .text.main.finishJsonDocument)
    . = ALIGN(4096);
    *(.text..Lfastq.Reader.consumeBufferedRecord .text.fastq.Reader.consumeBufferedRecord)
    *(.text..Lfastq.Reader.ingestLine .text.fastq.Reader.ingestLine)
    *(.text..LIo.Writer.printValue__anon_* .text.Io.Writer.printValue__anon_*)
    *(.text..L__udivti3 .text.__udivti3)
    *(.text..Lcompiler_rt.udivmod.udivmod__anon_* .text.compiler_rt.udivmod.udivmod__anon_*)
    *(.text..Lfastq.Reader.takeLineBytes__anon_* .text.fastq.Reader.takeLineBytes__anon_*)
    *(.text..Lmain.runStats .text.main.runStats)
    *(.text..Lmain.statsInput .text.main.statsInput)
    *(.text..Lstats.Stats.addRecord .text.stats.Stats.addRecord)
    *(.text..Lstats.StreamedTotals.add .text.stats.StreamedTotals.add)
    *(.text..Lmain.writeEscapedAll .text.main.writeEscapedAll)
    *(.text..Lmain.writeRatioField .text.main.writeRatioField)
    *(.text..Lmain.writeUnsignedField .text.main.writeUnsignedField)
    *(.text..LIo.Writer.splatByteAll .text.Io.Writer.splatByteAll)
    *(.text..LIo.Writer.writeAll .text.Io.Writer.writeAll)
    *(.text..Lfmt.float.render__anon_* .text.fmt.float.render__anon_*)
    *(.text..L__floattidf .text.__floattidf)
    *(.text..Lmain.writeStatsResultFields .text.main.writeStatsResultFields)
    . = ALIGN(4096);
    *(.text..Lfastq.LineFeedSearch.findLines__anon_* .text.fastq.LineFeedSearch.findLines__anon_*)
    *(.text..Lfastq.Reader.readLine__anon_* .text.fastq.Reader.readLine__anon_*)
    *(.text..Lheap.PageAllocator.free .text.heap.PageAllocator.free)
    *(.text..Lheap.debug_allocator.DebugAllocator*.free .text.heap.debug_allocator.DebugAllocator*.free)
    *(.text..Lio.fileSinkDrain .text.io.fileSinkDrain)
    *(.text..Lio.fileSinkFlushWriter .text.io.fileSinkFlushWriter)
    *(.text..Lmain.writeCheckedRecord .text.main.writeCheckedRecord)
    *(.text..Lio.fileSinkWrite .text.io.fileSinkWrite)
    *(.text..Lheap.debug_allocator.DebugAllocator*.remap .text.heap.debug_allocator.DebugAllocator*.remap)
    *(.text..Lfastq.FallbackValidation.consume .text.fastq.FallbackValidation.consume)
    *(.text..Lfastq.Reader.readValidatedHeader .text.fastq.Reader.readValidatedHeader)
    *(.text..Lmain.runSample .text.main.runSample)
    *(.text..Lmem.Allocator.realloc__anon_* .text.mem.Allocator.realloc__anon_*)
    *(.text..Lsample.Mt19937_64.nextUnitFloat .text.sample.Mt19937_64.nextUnitFloat)
    *(.text..Lmain.sampleFractionInput .text.main.sampleFractionInput)
    *(.text..Lsample.Selector.init .text.sample.Selector.init)
    *(.text..Ldebug.captureCurrentStackTrace .text.debug.captureCurrentStackTrace)
    *(.text..Lhash_map.HashMapUnmanaged*.ensureUnusedCapacity .text.hash_map.HashMapUnmanaged*.ensureUnusedCapacity)
    *(.text..Lhash_map.HashMapUnmanaged*.getOrPutAssumeCapacity .text.hash_map.HashMapUnmanaged*.getOrPutAssumeCapacity)
    *(.text..Lhash_map.HashMapUnmanaged*.grow .text.hash_map.HashMapUnmanaged*.grow)
    *(.text..Lheap.debug_allocator.DebugAllocator*.freeLarge .text.heap.debug_allocator.DebugAllocator*.freeLarge)
    *(.text..Lfastq.Reader.bufferIncompleteRecord .text.fastq.Reader.bufferIncompleteRecord)
    *(.text..Lfastq.Reader.readBufferedRecord__anon_* .text.fastq.Reader.readBufferedRecord__anon_*)
    *(.text..Lfastq.nextValidatedRecord .text.fastq.nextValidatedRecord)
    . = ALIGN(4096);
    *(.text..Lpair.headersMatch .text.pair.headersMatch)
    *(.text..Lpair.illuminaName .text.pair.illuminaName)
    *(.text..Lpair.matchingTokenEnd .text.pair.matchingTokenEnd)
    *(.text..Lpair.tokenEnd .text.pair.tokenEnd)
    *(.text..Lfastq.nextSavedPairMate .text.fastq.nextSavedPairMate)
    *(.text..Lfastq.readBufferedValidatedRecord .text.fastq.readBufferedValidatedRecord)
    *(.text..Lmain.checkPairMode .text.main.checkPairMode)
    *(.text..Lmain.runPairedCheckCommand .text.main.runPairedCheckCommand)
    *(.text..Lfastq.nextBufferedValidatedRecord .text.fastq.nextBufferedValidatedRecord)
    *(.text..Lfastq.nextValidatedMatePreservingHeader .text.fastq.nextValidatedMatePreservingHeader)
    *(.text..Lmain.checkInterleavedSource .text.main.checkInterleavedSource)
    *(.text..Lmain.checkSpanPairs .text.main.checkSpanPairs)
    *(.text..Lposix.openat .text.posix.openat)
    *(.text..Lmain.initPairedRecordInputs .text.main.initPairedRecordInputs)
    *(.text..Lmain.pairedFilesFailure .text.main.pairedFilesFailure)
    *(.text..Lmain.prepareRecordFile .text.main.prepareRecordFile)
    *(.text..Lmain.checkPairedSources .text.main.checkPairedSources)
    . = ALIGN(4096);
    *(.text..Lmain.interleaveInputs .text.main.interleaveInputs)
    *(.text..Lmain.interleaveSources .text.main.interleaveSources)
    *(.text..Lmain.joinSpanPairs .text.main.joinSpanPairs)
    *(.text..Lmain.runInterleave .text.main.runInterleave)
    . = ALIGN(4096);
    *(.text..LIo.Threaded.dirCreateFilePosix .text.Io.Threaded.dirCreateFilePosix)
    *(.text..LIo.Threaded.fileWritePositional .text.Io.Threaded.fileWritePositional)
    *(.text..Lmain.RecordInput.stream .text.main.RecordInput.stream)
    *(.text..Lmain.RecordOutput.create .text.main.RecordOutput.create)
    *(.text..Lfastq.nextValidatedMatePreservingRecord .text.fastq.nextValidatedMatePreservingRecord)
    *(.text..Lmain.readInterleavedPair .text.main.readInterleavedPair)
    *(.text..Lmain.recordHasUnwritableEnding .text.main.recordHasUnwritableEnding)
    *(.text..Lmain.splitSpanPairs .text.main.splitSpanPairs)
    *(.text..Lio.fileSinkFlush .text.io.fileSinkFlush)
    *(.text..Lmain.deinterleaveSource .text.main.deinterleaveSource)
    *(.text..Lmain.runDeinterleave .text.main.runDeinterleave)
    . = ALIGN(4096);
    *(.text..LIo.Threaded.fileStatLinux .text.Io.Threaded.fileStatLinux)
    *(.text..Larray_list.Aligned*.ensureTotalCapacityPrecise .text.array_list.Aligned*.ensureTotalCapacityPrecise)
    *(.text..Lfastq.Reader.advance .text.fastq.Reader.advance)
    *(.text..Lmain.considerExactRecords .text.main.considerExactRecords)
    *(.text..Lmain.initExactInput .text.main.initExactInput)
    *(.text..Lmain.openExactInput .text.main.openExactInput)
    *(.text..Lmain.sampleExactFile .text.main.sampleExactFile)
    *(.text..Lsample.ExactSelector.activateUpperBits .text.sample.ExactSelector.activateUpperBits)
    *(.text..Lsample.ExactSelector.considerPreparedRecord .text.sample.ExactSelector.considerPreparedRecord)
    *(.text..Lsample.ExactSelector.finish .text.sample.ExactSelector.finish)
    *(.text..Lsample.appendUpperBoundaries .text.sample.appendUpperBoundaries)
    *(.text..Lsample.parseDecimal__anon_* .text.sample.parseDecimal__anon_*)
    *(.text..Lmain.runPairSampleCommand .text.main.runPairSampleCommand)
    . = ALIGN(4096);
    *(.text..Lmain.ProcessCollectors.deinit .text.main.ProcessCollectors.deinit)
    *(.text..Lmain.QcTables.deinit .text.main.QcTables.deinit)
    *(.text..Lmain.RecordOutput.finish .text.main.RecordOutput.finish)
    *(.text..Lmain.processReadOptions .text.main.processReadOptions)
    *(.text..Lmain.processSources .text.main.processSources)
    *(.text..Lmain.processSpanPairs .text.main.processSpanPairs)
    *(.text..Lmain.runProcess .text.main.runProcess)
    *(.text..Lqc.MateQc.deinit .text.qc.MateQc.deinit)
    *(.text..Lqc.PendingQuality.deinit .text.qc.PendingQuality.deinit)
    *(.text..Lqc.QualityBins.deinit .text.qc.QualityBins.deinit)
    *(.text..Lqc.TileQuality.deinit .text.qc.TileQuality.deinit)
    *(.text..Lmain.finishCollectors .text.main.finishCollectors)
    *(.text..Lqc.MatePopulations.addRead .text.qc.MatePopulations.addRead)
    *(.text..Lqc.MatePopulations.materialize .text.qc.MatePopulations.materialize)
    *(.text..Lqc.MateQc.collect .text.qc.MateQc.collect)
    *(.text..Lqc.MateQc.finish .text.qc.MateQc.finish)
    *(.text..Lqc.MateQc.growCycles .text.qc.MateQc.growCycles)
    *(.text..Lqc.MateQc.tableStats .text.qc.MateQc.tableStats)
    *(.text..Lheap.PageAllocator.remap .text.heap.PageAllocator.remap)
    *(.text..Lheap.debug_allocator.DebugAllocator*.resizeLarge .text.heap.debug_allocator.DebugAllocator*.resizeLarge)
    *(.text..Lmain.createExclusiveOutput .text.main.createExclusiveOutput)
    *(.text..Larray_list.Aligned*.append .text.array_list.Aligned*.append)
    *(.text..Lmain.processArguments .text.main.processArguments)
    *(.text..Lmain.writeQcSummary .text.main.writeQcSummary)
    *(.text..Lmain.writeSummaryFile .text.main.writeSummaryFile)
    *(.text..Lpreprocess.PairDuplication.deinit .text.preprocess.PairDuplication.deinit)
    *(.text..Lpreprocess.PairDuplication.flush .text.preprocess.PairDuplication.flush)
    *(.text..Lpreprocess.PairDuplication.hash .text.preprocess.PairDuplication.hash)
    *(.text..Lpreprocess.PairDuplication.push .text.preprocess.PairDuplication.push)
    *(.text..Lpreprocess.PairDuplication.record .text.preprocess.PairDuplication.record)
    *(.text..Lpreprocess.PairDuplication.sumsVector .text.preprocess.PairDuplication.sumsVector)
    *(.text..Lpreprocess.PositionSet.grow .text.preprocess.PositionSet.grow)
    *(.text..Lengine.encode.BitWriter.drain .text.engine.encode.BitWriter.drain)
    *(.text..Lengine.encode.EncodeTree.build .text.engine.encode.EncodeTree.build)
    *(.text..Lengine.encode.Encoder.Plan.init .text.engine.encode.Encoder.Plan.init)
    *(.text..Lengine.encode.Encoder.clear__anon_* .text.engine.encode.Encoder.clear__anon_*)
    *(.text..Lengine.encode.Encoder.codeWindow__anon_* .text.engine.encode.Encoder.codeWindow__anon_*)
    *(.text..Lengine.encode.Encoder.emitIcf .text.engine.encode.Encoder.emitIcf)
    *(.text..Lengine.encode.Encoder.emitPlanned .text.engine.encode.Encoder.emitPlanned)
    *(.text..Lengine.encode.matchLength .text.engine.encode.matchLength)
    *(.text..Lio.gzipSinkWrite .text.io.gzipSinkWrite)
    *(.text..Lsort.pdq.partialInsertionSort__anon_* .text.sort.pdq.partialInsertionSort__anon_*)
    *(.text..Lstream.writer.Compressor*.drain .text.stream.writer.Compressor*.drain)
    *(.text..Lio.fileSinkWriteVec .text.io.fileSinkWriteVec)
    *(.text..Lio.writeVecToWriter .text.io.writeVecToWriter)
    *(.text..Lmain.ProcessPairs.emitTransformed .text.main.ProcessPairs.emitTransformed)
    *(.text..Lpreprocess.readReason .text.preprocess.readReason)
    *(.text..Lmain.adapterOption__anon_* .text.main.adapterOption__anon_*)
    *(.text..Lmain.rangeOption__anon_* .text.main.rangeOption__anon_*)
    *(.text..Lpreprocess.firstAccepted__anon_* .text.preprocess.firstAccepted__anon_*)
    *(.text..Lpreprocess.longestGapMatch .text.preprocess.longestGapMatch)
    *(.text..Lpreprocess.reverseComplement__anon_* .text.preprocess.reverseComplement__anon_*)
    *(.text..Lqc.KeyForm.fill .text.qc.KeyForm.fill)
    *(.text..Lqc.MateQc.AdapterRows.next .text.qc.MateQc.AdapterRows.next)
    *(.text..Lqc.MateQc.addSummary .text.qc.MateQc.addSummary)
    *(.text..Lqc.MateQc.groupContent .text.qc.MateQc.groupContent)
    *(.text..Lqc.MateQc.groupN .text.qc.MateQc.groupN)
    *(.text..Lqc.MateQc.groupPercentile .text.qc.MateQc.groupPercentile)
    *(.text..Lqc.SequenceCounts.add .text.qc.SequenceCounts.add)
    *(.text..Lqc.SequenceCounts.finish .text.qc.SequenceCounts.finish)
    *(.text..Lqc.SequenceCounts.grow .text.qc.SequenceCounts.grow)
    *(.text..Lqc.SequenceCounts.keyText .text.qc.SequenceCounts.keyText)
    *(.text..Lqc.TileQuality.addSampled .text.qc.TileQuality.addSampled)
    *(.text..Lqc.TileTable.deviations .text.qc.TileTable.deviations)
    *(.text..Lqc.TileTable.init .text.qc.TileTable.init)
    *(.text..Lqc.addBinnedQualities__anon_* .text.qc.addBinnedQualities__anon_*)
    *(.text..Lqc.endsInRun .text.qc.endsInRun)
    *(.text..Lqc.firstAdapterMatches .text.qc.firstAdapterMatches)
    *(.text..Lqc.rangeLabel .text.qc.rangeLabel)
    *(.text..Lsort.pdq.breakPatterns__anon_* .text.sort.pdq.breakPatterns__anon_*)
    *(.text..Lmain.writeProcessReport .text.main.writeProcessReport)
    *(.text..Lmain.writeReasonCounts .text.main.writeReasonCounts)
    *(.text..Lqc.MatePopulations.removeCycles .text.qc.MatePopulations.removeCycles)
    *(.text..Lqc.MateQc.writeJson .text.qc.MateQc.writeJson)
    *(.text..LIo.Threaded.dirAccessPosix .text.Io.Threaded.dirAccessPosix)
    *(.text..LIo.Threaded.dirCreateDirPath .text.Io.Threaded.dirCreateDirPath)
    *(.text..LIo.Threaded.dirCreateDirPosix .text.Io.Threaded.dirCreateDirPosix)
    *(.text..LIo.Writer.Allocating.drain .text.Io.Writer.Allocating.drain)
    *(.text..Lexp .text.exp)
    *(.text..Lfs.path.join .text.fs.path.join)
    *(.text..Llog .text.log)
    *(.text..Lmain.QcTables.create .text.main.QcTables.create)
    *(.text..Lmain.QcTables.write .text.main.QcTables.write)
    *(.text..Lmath.frexp.frexp__anon_* .text.math.frexp.frexp__anon_*)
    *(.text..Lmath.ldexp.ldexp__anon_* .text.math.ldexp.ldexp__anon_*)
    *(.text..Lmath.pow.pow__anon_* .text.math.pow.pow__anon_*)
    *(.text..Lqc.MateQc.writeQcTable .text.qc.MateQc.writeQcTable)
    *(.text..Lqc.beginModule .text.qc.beginModule)
    *(.text..Lqc.javaDouble .text.qc.javaDouble)
    *(.text..Lqc.writeCell .text.qc.writeCell)
    *(.text..Lmain.optionValue__anon_* .text.main.optionValue__anon_*)
    *(.text..Lmain.writeTaggedRecord .text.main.writeTaggedRecord)
    *(.text..Lmeta.stringToEnum__anon_* .text.meta.stringToEnum__anon_*)
  }
}
INSERT BEFORE .text;
